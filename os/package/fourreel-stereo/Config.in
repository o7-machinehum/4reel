## os/package/fourreel-stereo/Config.in
```kconfig
config BR2_PACKAGE_FOURREEL_STEREO
	bool "4reel stereo ZipDepth development pipeline"
	depends on BR2_ARM_CPU_HAS_NEON
	help
	  Native triggered calibration capture and genuine RV1103 ZipDepth,
	  with per-unit DS geometry and bounded CPU sparse stereo.
	  Requires the verified local bundle described in STEREO_ZIPDEPTH.md.
	  Hardware validation is still required; no factory calibration included.
```

## os/package/fourreel-web/Config.in
```kconfig
config BR2_PACKAGE_FOURREEL_WEB
	bool "4reel camera web dashboard"
	depends on BR2_arm && BR2_ARM_EABIHF
	depends on BR2_TOOLCHAIN_USES_MUSL
	depends on BR2_TOOLCHAIN_HAS_THREADS && BR2_USE_MMU
	select BR2_PACKAGE_ROCKCHIP_RVE
	select BR2_PACKAGE_ROCKCHIP_RKNN
	help
	  Device-hosted stereo and ZipDepth previews, fisheye calibration,
	  camera controls, and accelerometer status. Listens on USB Ethernet only.
```

## os/package/rockchip-rknn/Config.in
```kconfig
config BR2_PACKAGE_ROCKCHIP_RKNN
	bool "Rockchip RV1103/RV1106 neural runtime"
	depends on BR2_arm && BR2_ARM_EABIHF && BR2_TOOLCHAIN_USES_MUSL
	depends on BR2_TOOLCHAIN_HAS_THREADS && BR2_USE_MMU
	select BR2_PACKAGE_LIBDRM
	help
	  Pinned RKNN mini runtime for the RV1103/RV1106 NPU, with the small
	  C-library compatibility layer needed by this musl image.
```
