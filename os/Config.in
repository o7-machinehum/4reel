## os/Config.in
```kconfig
source "$BR2_EXTERNAL_FOURREEL_PATH/package/rockchip-rve/Config.in"
source "$BR2_EXTERNAL_FOURREEL_PATH/package/fourreel-web/Config.in"
```

## os/board/rv1103g/uboot_defconfig
```kconfig
CONFIG_ARM=y
CONFIG_SKIP_LOWLEVEL_INIT=y
CONFIG_COUNTER_FREQUENCY=24000000
CONFIG_SYS_ARCH_TIMER=y
CONFIG_ARCH_ROCKCHIP=y
CONFIG_TEXT_BASE=0x00200000
CONFIG_SYS_MALLOC_F_LEN=0x80000
CONFIG_SPL_LIBCOMMON_SUPPORT=y
CONFIG_SPL_LIBGENERIC_SUPPORT=y
CONFIG_NR_DRAM_BANKS=1
CONFIG_HAS_CUSTOM_SYS_INIT_SP_ADDR=y
CONFIG_CUSTOM_SYS_INIT_SP_ADDR=0x00400000
# CONFIG_SPL_DM_SPI is not set
CONFIG_DEFAULT_DEVICE_TREE="rv1103g-4reel"
CONFIG_SPL_SYS_MALLOC_F_LEN=0x100000
CONFIG_ROCKCHIP_RV1106=y
CONFIG_SPL_ROCKCHIP_COMMON_BOARD=y
CONFIG_ROCKCHIP_EXTERNAL_TPL=y
CONFIG_ROCKCHIP_MASKROM_IMAGE=y
CONFIG_SPL_SERIAL=y
CONFIG_TARGET_LUCKFOX_PICO_RV1103=y
CONFIG_SYS_BOOTM_LEN=0x04000000
CONFIG_SYS_LOAD_ADDR=0x00008000
CONFIG_DEBUG_UART_BASE=0xff4c0000
CONFIG_DEBUG_UART_CLOCK=24000000
# CONFIG_DEBUG_UART_BOARD_INIT is not set
CONFIG_DEBUG_UART=y
# CONFIG_EFI_LOADER is not set
CONFIG_FIT=y
CONFIG_FIT_SIGNATURE=y
CONFIG_FIT_CIPHER=y
CONFIG_FIT_VERBOSE=y
CONFIG_FIT_BEST_MATCH=y
CONFIG_LEGACY_IMAGE_FORMAT=y
CONFIG_BOOTDELAY=1
# CONFIG_DISPLAY_CPUINFO is not set
CONFIG_LAST_STAGE_INIT=y
CONFIG_SPL_NO_BSS_LIMIT=y
CONFIG_CMD_GPIO=y
CONFIG_CMD_MMC=y
# CONFIG_CMD_SETEXPR is not set
CONFIG_CMD_CACHE=y
CONFIG_CMD_TIME=y
CONFIG_SPL_OF_CONTROL=y
CONFIG_ENV_RELOC_GD_ENV_ADDR=y
CONFIG_ENV_USE_DEFAULT_ENV_TEXT_FILE=y
CONFIG_NO_NET=y
CONFIG_SPL_DM_SEQ_ALIAS=y
CONFIG_SYSCON=y
CONFIG_SPL_SYSCON=y
CONFIG_CLK=y
CONFIG_SPL_CLK=y
CONFIG_ROCKCHIP_GPIO=y
CONFIG_SYS_I2C_ROCKCHIP=y
CONFIG_MMC_DW=y
CONFIG_MMC_DW_ROCKCHIP=y
# CONFIG_MTD is not set
CONFIG_PINCTRL=y
CONFIG_SPL_PINCTRL=y
CONFIG_DM_REGULATOR_FIXED=y
CONFIG_DEBUG_UART_SHIFT=2
CONFIG_SYS_NS16550_MEM32=y
# CONFIG_SPI is not set
CONFIG_SYSRESET=y
CONFIG_FAT_RENAME=y
CONFIG_REGEX=y
# CONFIG_RSA is not set
# CONFIG_SPL_SHA1 is not set
# CONFIG_SPL_SHA256 is not set
CONFIG_LZMA=y
CONFIG_ERRNO_STR=y
```

## os/configs/rv1103g_defconfig
```kconfig
BR2_arm=y
BR2_cortex_a7=y
BR2_ARM_FPU_NEON_VFPV4=y
BR2_TOOLCHAIN_BUILDROOT_MUSL=y
BR2_GLOBAL_PATCH_DIR="$(BR2_EXTERNAL_FOURREEL_PATH)/board/rv1103g/patches"
BR2_TARGET_GENERIC_HOSTNAME="4reel"
BR2_TARGET_GENERIC_ISSUE="4reel RV1103G1 Buildroot"
BR2_TARGET_GENERIC_GETTY_PORT="ttyS2"
BR2_TARGET_GENERIC_GETTY_BAUDRATE_115200=y
BR2_ROOTFS_OVERLAY="$(BR2_EXTERNAL_FOURREEL_PATH)/board/rv1103g/rootfs-overlay"
BR2_ROOTFS_POST_IMAGE_SCRIPT="support/scripts/genimage.sh"
BR2_ROOTFS_POST_SCRIPT_ARGS="-c $(BR2_EXTERNAL_FOURREEL_PATH)/board/rv1103g/genimage.cfg"
BR2_LINUX_KERNEL=y
BR2_LINUX_KERNEL_CUSTOM_TARBALL=y
BR2_LINUX_KERNEL_CUSTOM_TARBALL_LOCATION="$(call github,rockchip-linux,kernel,77168c8d5ab82399f65a80e9f807b50ba37cf483)/kernel-77168c8d5ab82399f65a80e9f807b50ba37cf483.tar.gz"
BR2_KERNEL_HEADERS_AS_KERNEL=y
BR2_PACKAGE_HOST_LINUX_HEADERS_CUSTOM_6_1=y
BR2_LINUX_KERNEL_USE_DEFCONFIG=y
BR2_LINUX_KERNEL_DEFCONFIG="rv1106"
BR2_LINUX_KERNEL_CONFIG_FRAGMENT_FILES="$(BR2_EXTERNAL_FOURREEL_PATH)/board/rv1103g/linux.fragment"
BR2_LINUX_KERNEL_DTS_SUPPORT=y
BR2_LINUX_KERNEL_CUSTOM_DTS_DIR="$(BR2_EXTERNAL_FOURREEL_PATH)/board/rv1103g/dts/linux"
BR2_LINUX_KERNEL_ZIMAGE=y
BR2_LINUX_KERNEL_XZ=y
BR2_TARGET_ROOTFS_EXT2=y
BR2_TARGET_ROOTFS_EXT2_4=y
BR2_TARGET_ROOTFS_EXT2_SIZE="128M"
# BR2_TARGET_ROOTFS_TAR is not set
BR2_TARGET_UBOOT=y
BR2_TARGET_UBOOT_BUILD_SYSTEM_KCONFIG=y
BR2_TARGET_UBOOT_CUSTOM_GIT=y
BR2_TARGET_UBOOT_CUSTOM_REPO_URL="https://github.com/u-boot/u-boot.git"
BR2_TARGET_UBOOT_CUSTOM_REPO_VERSION="ee5d46b45ec0c63f8f9dd1e816e0dac3452ccc3d"
BR2_TARGET_UBOOT_BOARD_DEFCONFIG="luckfox-pico-mini-b-rv1103"
BR2_TARGET_UBOOT_CONFIG_FRAGMENT_FILES="$(BR2_EXTERNAL_FOURREEL_PATH)/board/rv1103g/uboot.fragment"
BR2_TARGET_UBOOT_DEFAULT_ENV_FILE="$(BR2_EXTERNAL_FOURREEL_PATH)/board/rv1103g/uboot.env"
BR2_TARGET_UBOOT_CUSTOM_DTS_PATH="$(BR2_EXTERNAL_FOURREEL_PATH)/board/rv1103g/dts/uboot/rv1103g-4reel.dts $(BR2_EXTERNAL_FOURREEL_PATH)/board/rv1103g/dts/uboot/rv1103g-4reel-u-boot.dtsi"
BR2_TARGET_UBOOT_NEEDS_DTC=y
BR2_TARGET_UBOOT_NEEDS_PYLIBFDT=y
BR2_TARGET_UBOOT_NEEDS_PYELFTOOLS=y
BR2_TARGET_UBOOT_USE_BINMAN=y
BR2_TARGET_UBOOT_NEEDS_OPENSSL=y
BR2_TARGET_UBOOT_FORMAT_CUSTOM=y
BR2_TARGET_UBOOT_FORMAT_CUSTOM_NAME="idbloader.img u-boot.img"
BR2_PACKAGE_ROCKCHIP_RKBIN=y
BR2_PACKAGE_ROCKCHIP_RKBIN_TPL_FILENAME="bin/rv11/rv1106_ddr_924MHz_v1.15.bin"
BR2_TARGET_UBOOT_NEEDS_ROCKCHIP_RKBIN=y
BR2_PACKAGE_HOST_DOSFSTOOLS=y
BR2_PACKAGE_HOST_GENIMAGE=y
BR2_PACKAGE_HOST_MTOOLS=y
BR2_PACKAGE_YAVTA=y
BR2_PACKAGE_DNSMASQ=y
# BR2_PACKAGE_DNSMASQ_TFTP is not set
BR2_PACKAGE_DROPBEAR=y
# BR2_PACKAGE_DROPBEAR_CLIENT is not set
BR2_PACKAGE_DROPBEAR_DISABLE_REVERSEDNS=y
```

## os/package/fourreel-vo/Config.in
```kconfig
config BR2_PACKAGE_FOURREEL_VO
	bool "4reel stereo visual odometry"
	depends on BR2_INSTALL_LIBSTDCPP
	help
	  Small on-device stereo visual odometry experiment using libviso2.
	  It requires rectified, synchronized cameras and measured calibration.
	  It is not a SLAM system and has no loop closure or NPU inference.

comment "4reel stereo visual odometry needs a C++ toolchain"
	depends on !BR2_INSTALL_LIBSTDCPP
```

## os/package/fourreel-web/Config.in
```kconfig
config BR2_PACKAGE_FOURREEL_WEB
	bool "4reel camera web dashboard"
	depends on BR2_arm && BR2_ARM_EABIHF
	select BR2_PACKAGE_ROCKCHIP_RVE
	help
	  Device-hosted stereo preview, approximate calibration and depth map,
	  camera controls, and accelerometer status. Listens on USB Ethernet only.
```

## os/package/rockchip-rve/Config.in
```kconfig
config BR2_PACKAGE_ROCKCHIP_RVE
	bool "Rockchip RVE userspace library"
	depends on BR2_arm
	depends on BR2_ARM_EABIHF
	help
	  Pinned vendor static library for the RV1103/RV1106 vision engine.
	  The hardware library is binary-only; it is linked into 4reel-web.
```
